## apps/system/meadowtest/Kconfig
```kconfig
#
# For a description of the syntax of this configuration file,
# see the file kconfig-language.txt in the NuttX tools repository.
#

config SYSTEM_MEADOWTEST
	tristate "Meadow developer test command"
	default n
	depends on SYSTEM_HCOM
	---help---
		Enable the meadowtest NSH command.  It runs the developer tests
		that are built into hcom (see apps/system/hcom/tests/developer_tests.c)
		from the NSH prompt:

		  meadowtest [-p <uint32_t>] [-v <uint32_t>]

		-p selects the test (0 lists the available tests) and -v is the
		value passed to the test.  Both default to 0.

		This is enabled by build.sh --nsh.  When enabled the developer
		tests also report their test list and results using printf.

if SYSTEM_MEADOWTEST

config SYSTEM_MEADOWTEST_PROGNAME
	string "Program name"
	default "meadowtest"
	---help---
		This is the name of the program that will be use when the NSH ELF
		program is installed.

config SYSTEM_MEADOWTEST_PRIORITY
	int "Task priority"
	default 100

config SYSTEM_MEADOWTEST_STACKSIZE
	int "Stack size"
	default DEFAULT_TASK_STACKSIZE

endif
```

## esp32/main/kconfig.projbuild
```kconfig
menu "Meadow COMMS Project Build Configuration"

    config ENABLE_DIAGNOSTIC_THREAD
        bool "Enable diagnostic thread"
        default n
        help
            This option enables the diagnostic thread for monitoring system performance.

    config DIAGNOSTICS_INTERVAL_MS
        int "Diagnostics interval (ms)"
        range 10000 60000
        default 30000
        help
            Interval for collecting diagnostic data and sending this through the logging channel.

            Range 10,000 to 60,000 milliseconds (10 seconds to 60 seconds).
            Default is 30,000 milliseconds (30 seconds).

    config HOOK_REGISTER_SIZE
        int "Hook register size"
        range 1000 10000
        default 4000
        depends on HEAP_USE_HOOKS
        help
            Number of pointers that can be stored in the hook register.  This is used to store information
            about heap memory allocations and deallocations in order to attempt to detect double frees.

    config TRACE_RECORD_NUM
        int "Number of standalone trace records"
        range 10 500
        default 100
        depends on HEAP_TRACING_STANDALONE
        help
            Number of records that can be stored in the trace buffer.  This is used to store information
            about heap memory allocations and deallocations in order to attempt to detect memory leaks.

    config ENABLE_DETAILED_TASK_DIAGNOSTICS
        bool "Enable detailed task diagnostics"
        default n
        help
            This option enables detailed task diagnostics to monitor task performance and detect issues.

    config ENABLE_PERFORMANCE_LOGGING
        bool "Enable performance logging"
        default n
        help
            This option enables performance logging to track system metrics.
endmenu
```

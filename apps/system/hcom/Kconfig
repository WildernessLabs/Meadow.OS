## nuttx/boards/arm/stm32f7/stm32f777zit6-meadow/Kconfig
```kconfig
#
# For a description of the syntax of this configuration file,
# see the file kconfig-language.txt in the NuttX tools repository.
#

if ARCH_BOARD_MEADOW_F7MICRO

config HCOM_FILESYSTEM_INIT
    bool "Enables HCOM FS initialization support"
    default y

config HCOM_MTD_STRESS_TEST
    bool "Enables HCOM MTD stress testing support"
    default n

config HCOM_MONO_STDERR_STDOUT
    bool "Enables HCOM routing of Mono stdout and stderr to PC/Mac"
    default y

config HCOM_MONO_REMOTE_DEBUGGING
    bool "Enables HCOM Mono remote debugging support"
    default y

config HCOM_COMMS_DEVICE_NAME
    string "Specifies the device name for HCOM communications"
    default "/dev/ttyACM0"

config MEADOW_CLOUD
    bool "Enables Meadow Cloud support"
    default n
    select CRYPTO_MBEDTLS

config MEADOW_ETHNET_INCLUDE_IN_BUILD
    bool "Build Meadow and include Ethernet for compute module"
    default n
    ---help---
    This must be used with a 'defconfig' file that includes the correct Ethernet configuration.

config MEADOW_CELL_INCLUDE_IN_BUILD
    bool "Build Meadow and include cell (PPP) network support"
    default n
    depends on NET
    select NETUTILS_PPPD
    ---help---
    Powers on the cell module at boot when the cell interface is selected
    in the configuration, and builds the hcom PPPD client that connects it.

config HCOM_ESP32_COMMS
    bool "Enables HCOM file download to the ESP32"
    default y

config MEADOW_WATCHDOGS
    bool "Enables the Meadow network deadlock watchdogs"
    default y
    depends on SCHED_LPWORK
    ---help---
    Arms a software watchdog around the usrsock socket, close and poll
    operations, all of which can block indefinitely if the ESP32
    coprocessor stops responding.  On expiry an exception is raised into
    the managed environment.  The expiry callback runs in interrupt
    context and defers its work to the low priority work queue, hence the
    dependency on SCHED_LPWORK.

config MEADOW_WATCHDOG_SLOTS
    int "Number of concurrently armed Meadow watchdogs"
    default 8
    depends on MEADOW_WATCHDOGS
    ---help---
    One watchdog timer is allocated from this pool for each guarded
    operation that is in flight.  When the pool is exhausted the operation
    runs unguarded, so this needs to cover the number of threads that can
    be inside those operations at the same time.

menu "ESP32 Coprocessor Configuration"
source "boards/arm/stm32f7/stm32f777zit6-meadow/Kconfig-ESP32"
endmenu

config ARCH_BOARD_MEADOW
    bool "Enables Meadow board features"
    default y

# See meadow-adc.c file, currently unused.
config MEADOW_ADC
    bool "Enables Meadow ADC support"

config MEADOW_HCOM
    bool "Enables Meadow HCOM support"
    default n

config MEADOW_PWR_MGMT_SUPPORT
    bool "Enables Meadow power management support"
    default n

config BOARD_DUAL_CDCACM
	bool "Enable ttyACM0 and ttyACM1"
	depends on CDCACM_COMPOSITE
	select ARCH_BOARD_COMMON
	---help---
		When this option is enabled the board will register two
		USB CDC/ACM interfaces.

config BOARD_USB_PORT2_NSH
	bool "Run NSH on ttyACM1 instead of syslog"
	depends on BOARD_DUAL_CDCACM && SYSTEM_NSH
	default n
	---help---
		Developer builds only, set by 'build.sh --dualcdc --nsh'. The
		second USB CDC/ACM port (ttyACM1) runs NSH instead of carrying
		syslog. See Documentation/DualCdcAcm.md.

choice
	prompt "Select Main Board Model"
	default BOARD_MEADOW_F7MICRO_DEFAULT
	---help---
		Select the mainboard model

config BOARD_MEADOW_F7MICRO_DEFAULT
	bool "Meadow F7 Micro Default"
	select ARCH_BOARD_COMMON
	---help---
		The default Meadow F7 Micro board with STM32F777,
		ESP32 for WiFi/Bluetooth, External Flash and RAM.

config BOARD_MEADOW_PROJECTLAB
	bool "ProjectLab Mainboard"
	select ARCH_BOARD_COMMON
	---help---
		ProjectLab is a main board with a Meadow F7Micro
		module soldered on it. The projectLab has a lot of
		sensors, RS485, a 3.2" TFT Display, and Grove, Qwiic
		and mikroBUS connectors for expansion.

config BOARD_MEADOW_F7_CORE_COMPUTE
	bool "F7 Core Compute Mainboard"
	select ARCH_BOARD_COMMON
	---help---
		The F7 Core Compute is a modular mainboard with basic
		features of F7-Micro, but with SDCard and Dual Ethernet.

endchoice # Select Main Board Model

endif # ARCH_BOARD_MEADOW_F7MICRO
```

## nuttx/boards/xtensa/esp32/esp32-2432S028/Kconfig
```kconfig
#
# For a description of the syntax of this configuration file,
# see the file kconfig-language.txt in the NuttX tools repository.
#

if ARCH_BOARD_ESP32_2432S028

<<<<<<<< HEAD:nuttx/boards/xtensa/esp32/esp32-2432S028/Kconfig
endif # ARCH_BOARD_ESP32_2432S028
========
config ARCH_X86_64_MMX
	bool "MMX support"
	depends on ARCH_HAVE_MMX
	default y

config ARCH_X86_64_SSE
	bool "SSE support"
	depends on ARCH_HAVE_SSE
	default y

config ARCH_X86_64_SSE2
	bool "SSE2 support"
	depends on ARCH_HAVE_SSE2
	default y

config ARCH_X86_64_SSE3
	bool "SSE3 support"
	depends on ARCH_HAVE_SSE3
	default n

config ARCH_X86_64_SSSE3
	bool "SSSE3 support"
	depends on ARCH_HAVE_SSSE3
	default n

config ARCH_X86_64_SSE41
	bool "SSE41 support"
	depends on ARCH_HAVE_SSE41
	default n

config ARCH_X86_64_SSE42
	bool "SSE42 support"
	depends on ARCH_HAVE_SSE42
	default n

config ARCH_X86_64_SSE4A
	bool "SSE4A support"
	depends on ARCH_HAVE_SSE4A
	default n

config ARCH_X86_64_AVX
	bool "AVX support"
	depends on ARCH_HAVE_AVX
	default n

config ARCH_X86_64_AVX512
	bool "AVX512 support"
	depends on ARCH_HAVE_AVX512
	default n

endif
>>>>>>>> 9e8753d6256619a7bfa72f4596eb1e481f1c97a2:nuttx/arch/x86_64/src/common/Kconfig
```

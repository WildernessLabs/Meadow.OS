 /****************************************************************************
 * espcp_uart_monitor.c
 *
 *   Copyright (C) 2024 Wilderness Labs. All rights reserved.
 *   Author: Mark Stevens
 *
 * Redistribution and use in source and binary forms, with or without
 * modification, are permitted provided that the following conditions
 * are met:
 *
 * 1. Redistributions of source code must retain the above copyright
 *    notice, this list of conditions and the following disclaimer.
 * 2. Redistributions in binary form must reproduce the above copyright
 *    notice, this list of conditions and the following disclaimer in
 *    the documentation and/or other materials provided with the
 *    distribution.
 * 3. Neither the name NuttX nor the names of its contributors may be
 *    used to endorse or promote products derived from this software
 *    without specific prior written permission.
 *
 * THIS SOFTWARE IS PROVIDED BY THE COPYRIGHT HOLDERS AND CONTRIBUTORS
 * "AS IS" AND ANY EXPRESS OR IMPLIED WARRANTIES, INCLUDING, BUT NOT
 * LIMITED TO, THE IMPLIED WARRANTIES OF MERCHANTABILITY AND FITNESS
 * FOR A PARTICULAR PURPOSE ARE DISCLAIMED. IN NO EVENT SHALL THE
 * COPYRIGHT OWNER OR CONTRIBUTORS BE LIABLE FOR ANY DIRECT, INDIRECT,
 * INCIDENTAL, SPECIAL, EXEMPLARY, OR CONSEQUENTIAL DAMAGES (INCLUDING,
 * BUT NOT LIMITED TO, PROCUREMENT OF SUBSTITUTE GOODS OR SERVICES; LOSS
 * OF USE, DATA, OR PROFITS; OR BUSINESS INTERRUPTION) HOWEVER CAUSED
 * AND ON ANY THEORY OF LIABILITY, WHETHER IN CONTRACT, STRICT
 * LIABILITY, OR TORT (INCLUDING NEGLIGENCE OR OTHERWISE) ARISING IN
 * ANY WAY OUT OF THE USE OF THIS SOFTWARE, EVEN IF ADVISED OF THE
 * POSSIBILITY OF SUCH DAMAGE.
 *
 ****************************************************************************/

/****************************************************************************
 * Included Files
 ****************************************************************************/

#include <nuttx/config.h>

#include <nuttx/compiler.h>
#include <fcntl.h>
#include <sys/types.h>
#include <stdio.h>
#include <stdlib.h>
#include <string.h>
#include <stdint.h>
#include <stdbool.h>
#include <signal.h>
#include <time.h>
#include <crc32.h>
#include <errno.h>
#include <debug.h>
#include <limits.h>
#include <poll.h>

#include <ctype.h>

#include "espcp_coprocessor.h"
#include "espcp_message_dispatcher.h"
#include "espcp_uart_monitor.h"

#include <meadow/hcom_shared_common.h>
#include <meadow/meadow_thread_config.h>

/****************************************************************************
 * Uncomment the #define below to turn on debug help macros.
 ****************************************************************************/
// #define USE_MEADOW_DEBUG_HELPERS
#include <meadow/meadow_debug_helpers.h>

/****************************************************************************
 * Pre-processor Definitions
 ****************************************************************************/

/**
 * @brief Number of bytes to allocate for the incoming line of text
 *        from the UART connected to the ESP32.
 */
#define ESPCP_NETWORK_MONITOR_BUFFER_LENGTH     256

/****************************************************************************
 * Local method prototypes.
 ****************************************************************************/

static void espcp_process_ready_control_signal(const char *);
static void espcp_process_message_waiting_control_signal(const char *);
static void espcp_process_spi_ready_control_signal(const char *);

/****************************************************************************
 * Local type definitions.
 ****************************************************************************/

/**
 * @brief Names for the control signals that can be generated by the system.
 */
typedef enum espcp_control_signal_e
{
    ESPCP_CONTROL_SIGNAL_RESET = 0,
    ESPCP_CONTROL_SIGNAL_READY = 1,
    ESPCP_CONTROL_SIGNAL_MESSAGE_WAITING = 2,
    ESPCP_CONTROL_SIGNAL_SPI_INTERFACE_READY = 3,
} espcp_control_signal_t;

/**
 * @brief Structure holding the names and text for the control signals.
 */
typedef struct espcp_control_signals_s
{
    /**
     * @brief Control signal enum value
     */
    espcp_control_signal_t control_signal;

    /**
     * @brief Text used to represent the control signal.
     */
    const char *text;

    /**
     * @brief Length of the text.
     */
    const int length;

    /**
     * @brief Event handler that should be called upon successful match.
     */
    void (*event_handler)(const char *);
} espcp_control_signals_t;

/****************************************************************************
 * Private Data
 ****************************************************************************/

/**
 * @brief Message names and types along with the event handlers for the messages.
 * 
 * This table should be ordered with the most common messages first.  This will
 * allow the most common message types to be detected quickly.
 */
static const espcp_control_signals_t _control_signals[] =
{
    //
    //  These messages are the ones that are most regularly sent by the ESP32.
    //
    { ESPCP_CONTROL_SIGNAL_SPI_INTERFACE_READY, "SIR", 3, espcp_process_spi_ready_control_signal },
    { ESPCP_CONTROL_SIGNAL_MESSAGE_WAITING, "MW", 2, espcp_process_message_waiting_control_signal },
    //
    //  The following messages happen infrequently in a well behaved system.
    //
    { ESPCP_CONTROL_SIGNAL_RESET, "RST", 3, espcp_process_reset_control_signal },
    { ESPCP_CONTROL_SIGNAL_READY, "RDY", 3, espcp_process_ready_control_signal },
};

/****************************************************************************
 * Private Functions
 ****************************************************************************/

/****************************************************************************
 * Public Functions
 ****************************************************************************/

/****************************************************************************
 *  Name: espcp_process_ready_control_signal
 *
 *  Description:
 *      Process the "+++RDY" signal from the ESP32.
 *
 *  Input Parameters:
 *      line - Line of text from the ESP32.
 *
 *  Returned Value:
 *      None.
 *
 *  Assumptions/Limitations:
 *      Case of the strings sent by the ESP32 matches those in this method.
 * 
 *      String is '\0' terminated and the '\n' character has been removed.
 *
 ****************************************************************************/
static void espcp_process_ready_control_signal(const char *line __attribute__((unused)))
{
    MEADOW_TRACE_INFORMATION("+++RDY\n");
}

/****************************************************************************
 *  Name: espcp_process_message_waiting_control_signal
 *
 *  Description:
 *      Process the "+++MW" signal from the ESP32.
 *
 *  Input Parameters:
 *      line - Line of text from the ESP32.
 *
 *  Returned Value:
 *      None.
 *
 *  Assumptions/Limitations:
 *      Case of the strings sent by the ESP32 matches those in this method.
 * 
 *      String is '\0' terminated and the '\n' character has been removed.
 *
 ****************************************************************************/
static void espcp_process_message_waiting_control_signal(const char *line __attribute((unused)))
{
    MEADOW_TRACE_INFORMATION("+++MW\n");
    espcp_queue_send_response_message();
}

/****************************************************************************
 *  Name: espcp_process_spi_ready_control_signal
 *
 *  Description:
 *      Process the "+++SIR" signal from the ESP32.
 *
 *  Input Parameters:
 *      line - Line of text from the ESP32.
 *
 *  Returned Value:
 *      None.
 *
 *  Assumptions/Limitations:
 *      Case of the strings sent by the ESP32 matches those in this method.
 * 
 *      String is '\0' terminated and the '\n' character has been removed.
 *
 ****************************************************************************/
static void espcp_process_spi_ready_control_signal(const char *line __attribute__((unused)))
{
    MEADOW_TRACE_INFORMATION("+++SIR\n");
    espcp_spi_interface_unlock();
}

/****************************************************************************
 *  Name: espcp_uart_monitor_process_line
 *
 *  Description:
 *      Process the line of text that has been sent by the ESP32.
 * 
 *      Control messages will all start with "+++" followed by a signal code.
 *          * MW - Message waiting (the most common message).
 *          * RST - ESP32 has just completed the reset sequence.
 * 
 *      Lines not starting with "+++" are log messages from the ESP32.
 *
 *  Input Parameters:
 *      line - Line of text from the ESP32.
 *
 *  Returned Value:
 *      None.
 *
 *  Assumptions/Limitations:
 *      Case of the strings sent by the ESP32 matches those in this method.
 * 
 *      String is '\0' terminated and the '\n' character has been removed.
 *
 ****************************************************************************/
void espcp_uart_monitor_process_line(char *line)
{
    if (line)
    {
        if (strncmp(line, "+++", 3) == 0)
        {
            for (int index = 0; index < sizeof(_control_signals) / sizeof(_control_signals[0]); index++)
            {
                if (strncmp(line + 3, _control_signals[index].text, _control_signals[index].length) == 0)
                {
                    _control_signals[index].event_handler(line);
                    return;
                }
            }
        }
        else
        {
            MEADOW_TRACE_INFORMATION("ESP Log: %s\n", line);
        }
    }
}

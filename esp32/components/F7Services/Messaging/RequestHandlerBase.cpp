/**
 * @file RequestHandlerBase.cpp
 * @author Mark Stevens
 * @brief Base class for the request handlers.
 * @date 2019-02-03
 *
 * @copyright Copyright (c) 2019 Wilderness Labs
 */

#include "sdkconfig.h"

#include "freertos/FreeRTOS.h"
#include "freertos/task.h"
#include "freertos/queue.h"
#include "esp_log.h"

#include "Encoders.hpp"
#include "RequestHandlerBase.hpp"
#include "Logging.hpp"
#include "MessageDispatcher.hpp"
#include "Utils.hpp"
#include "RequestHandlerBase.hpp"
#include "TransportProviderBase.hpp"

/*
 * ---------------------------------------------------------------------------
 *
 *                     Initialise static data.
 *
 * ---------------------------------------------------------------------------
 */

/**
 *  @brief Name of this component / task.
 */
const char *RequestHandlerBase::COMPONENT_NAME = "RequestHandlerBase";

/**
 *  @brief MessageDispatcher object that ensure that messages are delivered to
 *  the correct part of the system.
 */
IMessageDispatcher *RequestHandlerBase::_messageDispatcher = nullptr;

/*
 * ---------------------------------------------------------------------------
 *
 *                     Constructors and destructor
 *
 * ---------------------------------------------------------------------------
 */

/**
 *  @brief Constructor for the RequestHandlerBase class.
 */
RequestHandlerBase::RequestHandlerBase() : _queueHandle(nullptr), _taskHandle(nullptr)
{
}

/**
 *  @brief Create a new request handler object and ensure that
 *  the message dispatcher reference is set up correctly.
 *
 *  @param messageDispatcher
 *      Message dispatcher object that will allow communication
 *      with the STM32.
 */
RequestHandlerBase::RequestHandlerBase(IMessageDispatcher *messageDispatcher) : RequestHandlerBase()
{
    _messageDispatcher = messageDispatcher;
}

/**
 *  @brief Destructor for the RequestHandlerBase class.
 */
RequestHandlerBase::~RequestHandlerBase()
{
}

/*
 * ----------------------------------------------------------------------------
 *
 *                      Getters and setters
 *
 * ----------------------------------------------------------------------------
 */

/* ---------------------------------------------------------------------------
 *
 *                              Methods
 *
 * ---------------------------------------------------------------------------
 */

/**
 *  @brief Setup the request handler.
 */
void RequestHandlerBase::Setup()
{
    _queueHandle = xQueueCreate(MAX_QUEUE_LENGTH, sizeof(Message *));
    if (_queueHandle == NULL)
    {
        ERROR_MESSAGE("Cannot allocate ESP32 handler queue.");
    }
}

/**
 *  @brief Process any messages for the controller.
 *
 *  The messages will be generated by the incoming SPI task.
 *
 *  @param pvParameters
 *      Pointer to the instance of the request handler receiving the
 *      messages for dispatch through the instance specific handler.
 */
void RequestHandlerBase::Task(void *pvParameters)
{
    RequestHandlerBase *sender = static_cast<RequestHandlerBase *>(pvParameters);
    while (true)
    {
        Message *message;
        BaseType_t result = xQueueReceive(sender->_queueHandle, &message, portMAX_DELAY);
        if ((result == pdTRUE) && (message != NULL))
        {
            //
            //  We check that the message is valid before dispatching it meaning
            //  that we don't have to do this in the request handlers.
            //
            sender->DispatchRequest(message);
        }
    }
    //
    //  We should only get here if the code in the while loop generates a fault.
    //  The documentation for FreeRTOS states that we should delete the task
    //  should we get here.
    //
    vTaskDelete(sender->_taskHandle);
}

/**
 *  @brief Add an incoming message to the queue of messages waiting to be processed.
 *
 *  @param message
 *      Message from the STM32 that needs to be queued.
 *
 *  @return
 *      true if the message could be queued, false if there was a problem.
 */
bool RequestHandlerBase::QueueEsp32Message(Message *message)
{
    bool result = true;
    Logging::DumpMessage(COMPONENT_NAME, message);
    if (xQueueSendToBack(_queueHandle, &message, 0) != pdPASS)
    {
        Message::DeleteMessage(message);
        result = false;
    }

    return (result);
}

/**
 *  @brief Create a new interrupt message and add it to the outbound message queue.
 *
 *  @param interface
 *      Interface to sent the event to.
 *
 *  @param eventType
 *      Type of event being raised.
 *
 *  @param statusCode
 *      Status code.
 *
 *  @param payload
 *      Event payload.
 *
 *  @param payloadLength
 *      Amount of data in the payload.
 */
void RequestHandlerBase::RaiseEvent(const uint8_t interface, const uint32_t eventType, const uint32_t statusCode, uint8_t *payload, const uint32_t payloadLength)
{
    TRACE_MESSAGE("Raising event %s", Logging::FunctionName(interface, eventType));
    Message *message = Message::CreateOnHeap(MessageTypes::Event, interface, eventType, statusCode, _messageDispatcher->GetNextMessageID(), payload, payloadLength);
    _messageDispatcher->QueueMessageForStm32(message);
}

/**
 *  @brief Create a new interrupt message and add it to the outbound message queue.
 *
 *  @param interface
 *      Interface to sent the event to.
 *
 *  @param eventType
 *      Type of event being raised.
 *
 *  @param statusCode
 *      Status code.
 */
void RequestHandlerBase::RaiseEvent(const uint8_t interface, const uint32_t eventType, const uint32_t statusCode)
{
    RaiseEvent(interface, eventType, statusCode, nullptr, 0);
}

/**
 *  @brief Create a new interrupt message and add it to the outbound message queue.
 *
 *  @param interface
 *      Interface to sent the event to.
 *
 *  @param eventType
 *      Type of event being raised.
 */
void RequestHandlerBase::RaiseEvent(const uint8_t interface, const uint32_t eventType)
{
    RaiseEvent(interface, eventType, StatusCodes::CompletedOk, nullptr, 0);
}

/**
 * @brief Send an IntegerResponse to the STM32.
 *
 * @param interface - The interface to sending the response.
 * @param eventType - The event type of the response.
 * @param statusCode - The status code of the response.
 * @param result - Value to send.
 */
void RequestHandlerBase::SendIntegerResult(const uint8_t interface, const uint32_t function, const uint32_t statusCode, const uint32_t value)
{
    TRACE_MESSAGE("SendIntegerResult - Enter");

    Esp32Messaging::IntegerResponse *response = new Esp32Messaging::IntegerResponse();

    if (response != NULL)
    {
        response->Result = value;
        uint32_t payloadLength = Encoders::EncodedIntegerResponseBufferSize(response);
        uint8_t *payload = static_cast<uint8_t *>(pvPortMalloc(payloadLength));

        if (payload != NULL)
        {
            Encoders::EncodeIntegerResponse(response, payload);
            RaiseEvent(interface, function, statusCode, payload, payloadLength);
        }
        Utils::DeleteAndNullifyPointer(reinterpret_cast<void **>(&response));
    }
    else
    {
        TRACE_MESSAGE("Failed to allocate memory for IntegerResponse");
    }

    TRACE_MESSAGE("SendIntegerResult - Exit");
}